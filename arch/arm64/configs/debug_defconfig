## arch/arm64/configs/debug_defconfig
```kconfig
CONFIG_CC_OPTIMIZE_FOR_SIZE=y
CONFIG_DEBUG_BUGVERBOSE=y
CONFIG_DEBUG_INFO=y
CONFIG_DEBUG_PREEMPT=y
CONFIG_FB_MSM_MDSS_XLOG_DEBUG=y
CONFIG_INPUT_EVBUG=y
CONFIG_IOSCHED_TEST=y
CONFIG_MMC_BLOCK_TEST=y
CONFIG_MMC_TEST=y
CONFIG_MSMB_CAMERA_DEBUG=y
CONFIG_MSM_CAMERA_DEBUG=y
CONFIG_SCHED_DEBUG=y
CONFIG_SLABINFO=y
CONFIG_SLUB_DEBUG=y
CONFIG_SYSRQ_SCHED_DEBUG=y
```

## arch/arm64/configs/variant_cno_cn_defconfig
```kconfig
CONFIG_BCM43455=y
CONFIG_BRCM_WAPI=y
CONFIG_DEFAULT_BIC=y
CONFIG_INET6_XFRM_MODE_BEET=y
CONFIG_INET6_XFRM_MODE_TRANSPORT=y
CONFIG_INET6_XFRM_MODE_TUNNEL=y
CONFIG_INET_XFRM_MODE_BEET=y
CONFIG_INET_XFRM_MODE_TRANSPORT=y
CONFIG_INET_XFRM_MODE_TUNNEL=y
CONFIG_IP6_NF_NAT=y
CONFIG_IP_MULTICAST=y
CONFIG_LGE_NFC_PN547_C2=y
CONFIG_LGE_NFC_SET_IRQ_WAKEUP=y
CONFIG_LGE_NFC=y
CONFIG_LGE_PM_BATT_MANAGER=y
CONFIG_LGE_QFPROM_SECHASH="2e1d68a19e9a833d84286fd7aa353d65d793c94ecf5e09623c95be41558f320c"
CONFIG_LGP_DATA_BUGFIX_IPV6_ADDRCONF_KERNEL_CRASH=y
CONFIG_LGP_DATA_TCPIP_SLAAC_IPV6_ALLOCATION_BOOSTER=y
CONFIG_LOG_CPU_MAX_BUF_SHIFT=15
CONFIG_MACH_MSM8996_H1_CNO_CN=y
CONFIG_MACH_MSM8996_H1_GLOBAL_COM=y
CONFIG_MDFPP_CCAUDIT=y
CONFIG_MEM_SHARE_QMI_SERVICE=y
CONFIG_MSM_BOOT_STATS=y
CONFIG_MSM_PACMAN=y
CONFIG_NETFILTER_NETLINK_LOG=y
CONFIG_NETFILTER_XT_MATCH_CONNBYTES=y
CONFIG_NETFILTER_XT_MATCH_QUOTA2_LOG=y
CONFIG_NETFILTER_XT_MATCH_TCPMSS=y
CONFIG_NETFILTER_XT_TARGET_LOG=y
CONFIG_NETFILTER_XT_TARGET_NFLOG=y
CONFIG_NETFILTER_XT_TARGET_TEE=y
CONFIG_NET_SCH_CBQ=y
CONFIG_NET_SCH_CHOKE=y
CONFIG_NET_SCH_DRR=y
CONFIG_NET_SCH_DSMARK=y
CONFIG_NET_SCH_GRED=y
CONFIG_NET_SCH_HFSC=y
CONFIG_NET_SCH_MQPRIO=y
CONFIG_NET_SCH_NETEM=y
CONFIG_NET_SCH_QFQ=y
CONFIG_NET_SCH_RED=y
CONFIG_NET_SCH_SFB=y
CONFIG_NET_SCH_SFQ=y
CONFIG_NET_SCH_TBF=y
CONFIG_NET_SCH_TEQL=y
CONFIG_NF_CONNTRACK_TIMEOUT=y
CONFIG_NF_CONNTRACK_TIMESTAMP=y
CONFIG_NF_NAT_IPV4=y
CONFIG_PRE_SELF_DIAGNOSIS=y
CONFIG_RMNET_DATA_DEBUG_PKT=y
CONFIG_SECCOMP=y
CONFIG_SND_USE_QUAT_MI2S=y
CONFIG_TCP_CONG_ADVANCED=y
CONFIG_TCP_CONG_BIC=y
CONFIG_XFRM_MIGRATE=y
CONFIG_XFRM_SUB_POLICY=y
```

## arch/arm64/configs/variant_f700s_defconfig
```kconfig
CONFIG_ANDROID_LOGGER=y
CONFIG_BCM4358=y
CONFIG_DEFAULT_BIC=y
CONFIG_DEFAULT_FULLMESH=y
CONFIG_DEFAULT_MPTCP_PM="fullmesh"
CONFIG_DEFAULT_MPTCP_SCHED="default"
CONFIG_DEFAULT_SCHEDULER=y
CONFIG_INET6_XFRM_MODE_BEET=y
CONFIG_INET6_XFRM_MODE_TRANSPORT=y
CONFIG_INET6_XFRM_MODE_TUNNEL=y
CONFIG_INET_XFRM_MODE_BEET=y
CONFIG_INET_XFRM_MODE_TRANSPORT=y
CONFIG_INET_XFRM_MODE_TUNNEL=y
CONFIG_IP6_NF_NAT=y
CONFIG_IP_MULTICAST=y
CONFIG_LGE_NFC_PN547_C2=y
CONFIG_LGE_NFC_SET_IRQ_WAKEUP=y
CONFIG_LGE_NFC=y
CONFIG_LGE_PM_BATT_MANAGER=y
CONFIG_LGE_QFPROM_SECHASH="2e1d68a19e9a833d84286fd7aa353d65d793c94ecf5e09623c95be41558f320c"
CONFIG_LGP_DATA_BUGFIX_IPV6_ADDRCONF_KERNEL_CRASH=y
CONFIG_LGP_DATA_TCPIP_MPTCP=y
CONFIG_LGP_DATA_TCPIP_SLAAC_IPV6_ALLOCATION_BOOSTER=y
CONFIG_LOG_CPU_MAX_BUF_SHIFT=15
CONFIG_MACH_LGE=y
CONFIG_MACH_MSM8996_H1_KR=y
CONFIG_MACH_MSM8996_H1_SKT_KR=y
CONFIG_MDFPP_CCAUDIT=y
CONFIG_MEM_SHARE_QMI_SERVICE=y
CONFIG_MMC_FFU=n
CONFIG_MMC_SDCARD_NO_CLK_SCALE=y
CONFIG_MPTCP_BINDER=y
CONFIG_MPTCP_FULLMESH=y
CONFIG_MPTCP_NDIFFPORTS=y
CONFIG_MPTCP_PM_ADVANCED=y
CONFIG_MPTCP_ROUNDROBIN=y
CONFIG_MPTCP_SCHED_ADVANCED=y
CONFIG_MPTCP=y
CONFIG_MSM_BOOT_STATS=y
CONFIG_MSM_PACMAN=y
CONFIG_NET_EMATCH_CMP=y
CONFIG_NET_EMATCH_META=y
CONFIG_NET_EMATCH_NBYTE=y
CONFIG_NET_EMATCH_TEXT=y
CONFIG_NETFILTER_NETLINK_LOG=y
CONFIG_NETFILTER_XT_MATCH_CONNBYTES=y
CONFIG_NETFILTER_XT_MATCH_QUOTA2_LOG=y
CONFIG_NETFILTER_XT_MATCH_TCPMSS=y
CONFIG_NETFILTER_XT_TARGET_LOG=y
CONFIG_NETFILTER_XT_TARGET_NFLOG=y
CONFIG_NETFILTER_XT_TARGET_NOTRACK=y
CONFIG_NET_SCH_CBQ=y
CONFIG_NET_SCH_CHOKE=y
CONFIG_NET_SCH_DRR=y
CONFIG_NET_SCH_DSMARK=y
CONFIG_NET_SCH_GRED=y
CONFIG_NET_SCH_HFSC=y
CONFIG_NET_SCH_MQPRIO=y
CONFIG_NET_SCH_NETEM=y
CONFIG_NET_SCH_QFQ=y
CONFIG_NET_SCH_RED=y
CONFIG_NET_SCH_SFB=y
CONFIG_NET_SCH_SFQ=y
CONFIG_NET_SCH_TBF=y
CONFIG_NET_SCH_TEQL=y
CONFIG_NF_CONNTRACK_TIMEOUT=y
CONFIG_NF_CONNTRACK_TIMESTAMP=y
CONFIG_NF_NAT_IPV4=y
CONFIG_NF_NAT_IPV6=y
CONFIG_SECCOMP=y
CONFIG_SECURE_TOUCH=y
CONFIG_TCP_CONG_ADVANCED=y
CONFIG_TCP_CONG_BIC=y
CONFIG_TCP_CONG_LIA=y
CONFIG_TCP_CONG_OLIA=y
CONFIG_TCP_CONG_WVEGAS=y
CONFIG_TRUSTONIC_TEE=y
CONFIG_XFRM_MIGRATE=y
CONFIG_XFRM_SUB_POLICY=y
```

## arch/arm64/configs/variant_h850_defconfig
```kconfig
CONFIG_ANDROID_LOGGER=y
CONFIG_BCM43455=y
CONFIG_BCMDHD_FOLLOW_AP_DTIM_PERIOD=y
CONFIG_DEFAULT_BIC=y
CONFIG_INET6_XFRM_MODE_BEET=y
CONFIG_INET6_XFRM_MODE_TRANSPORT=y
CONFIG_INET6_XFRM_MODE_TUNNEL=y
CONFIG_INET_XFRM_MODE_BEET=y
CONFIG_INET_XFRM_MODE_TRANSPORT=y
CONFIG_INET_XFRM_MODE_TUNNEL=y
CONFIG_IP6_NF_NAT=y
CONFIG_IP_NF_SECURITY=y
CONFIG_LGE_NFC_PN547_C2=y
CONFIG_LGE_NFC_SET_IRQ_WAKEUP=y
CONFIG_LGE_NFC=y
CONFIG_LGE_PM_BATT_MANAGER=y
CONFIG_LGE_QFPROM_SECHASH="2e1d68a19e9a833d84286fd7aa353d65d793c94ecf5e09623c95be41558f320c"
CONFIG_LGE_SP_MIRRORING_CTRL_BL=y
CONFIG_LGP_DATA_BUGFIX_IPV6_ADDRCONF_KERNEL_CRASH=y
CONFIG_LGP_DATA_IMPROVE_QCT_EPDG_CONNECTION_TIME=y
CONFIG_LGP_DATA_TCPIP_SLAAC_IPV6_ALLOCATION_BOOSTER=y
CONFIG_LOG_CPU_MAX_BUF_SHIFT=15
CONFIG_MACH_LGE=y
CONFIG_MACH_MSM8996_H1_GLOBAL_COM=y
CONFIG_MDFPP_CCAUDIT=y
CONFIG_MEM_SHARE_QMI_SERVICE=y
CONFIG_MMC_FFU=n
CONFIG_MMC_SDCARD_NO_CLK_SCALE=y
CONFIG_MOBICORE_DRIVER=y
CONFIG_MSM_BOOT_STATS=y
CONFIG_MSM_PACMAN=y
CONFIG_NET_ACT_GACT=y
CONFIG_NET_ACT_MIRRED=y
CONFIG_NET_ACT_SKBEDIT=y
CONFIG_NET_EMATCH_CMP=y
CONFIG_NET_EMATCH_META=y
CONFIG_NET_EMATCH_NBYTE=y
CONFIG_NET_EMATCH_TEXT=y
CONFIG_NETFILTER_NETLINK_LOG=y
CONFIG_NETFILTER_XT_MATCH_DSCP=y
CONFIG_NETFILTER_XT_MATCH_QUOTA2_LOG=y
CONFIG_NETFILTER_XT_TARGET_LOG=y
CONFIG_NETFILTER_XT_TARGET_NFLOG=y
CONFIG_NETFILTER_XT_TARGET_NOTRACK=y
CONFIG_NETFILTER_XT_TARGET_TEE=y
CONFIG_NF_NAT_IPV4=y
CONFIG_RMNET_DATA_DEBUG_PKT=y
CONFIG_SECCOMP=y
CONFIG_SECURE_TOUCH=y
CONFIG_SND_USE_QUAT_MI2S=y
```

## arch/arm64/configs/variant_kddi_jp_defconfig
```kconfig
CONFIG_ANDROID_LOGGER=y
CONFIG_BCM43455=y
CONFIG_CMA_SIZE_MBYTES=8
CONFIG_CXD224X_NFC_RST=y
CONFIG_CXD224X_NFC=y
CONFIG_DEFAULT_BIC=y
CONFIG_DVB_CORE=y
CONFIG_DVB_MPQ_DEMUX=y
CONFIG_DVB_MPQ_TSPP1=y
CONFIG_DVB_MPQ=y
CONFIG_IP_MULTICAST=y
CONFIG_LGE_PM_BATT_MANAGER=y
CONFIG_LGE_QFPROM_SECHASH="2e1d68a19e9a833d84286fd7aa353d65d793c94ecf5e09623c95be41558f320c"
CONFIG_LGP_DATA_BUGFIX_IPV6_ADDRCONF_KERNEL_CRASH=y
CONFIG_LGP_DATA_TCPIP_SLAAC_IPV6_ALLOCATION_BOOSTER=y
CONFIG_LGP_DATA_TCPIP_TCP_SYN_RETRY_CONFIG_UPLUS=y
CONFIG_MACH_LGE=y
CONFIG_MACH_MSM8996_H1_KDDI_JP=y
CONFIG_MEDIA_DIGITAL_TV_SUPPORT=y
CONFIG_MEM_SHARE_QMI_SERVICE=y
CONFIG_MMC_FFU=n
CONFIG_MMC_SDCARD_NO_CLK_SCALE=y
CONFIG_MSM_PACMAN=y
CONFIG_NETFILTER_XT_MATCH_CONNBYTES=y
CONFIG_NETFILTER_XT_MATCH_TCPMSS=y
CONFIG_NETFILTER_XT_TARGET_NFLOG=y
CONFIG_NETFILTER_XT_TARGET_TEE=y
CONFIG_NET_SCH_CBQ=y
CONFIG_NET_SCH_CHOKE=y
CONFIG_NET_SCH_DRR=y
CONFIG_NET_SCH_DSMARK=y
CONFIG_NET_SCH_GRED=y
CONFIG_NET_SCH_HFSC=y
CONFIG_NET_SCH_MQPRIO=y
CONFIG_NET_SCH_NETEM=y
CONFIG_NET_SCH_QFQ=y
CONFIG_NET_SCH_RED=y
CONFIG_NET_SCH_SFB=y
CONFIG_NET_SCH_SFQ=y
CONFIG_NET_SCH_TBF=y
CONFIG_NET_SCH_TEQL=y
CONFIG_NFC_NQ=y
CONFIG_NF_CONNTRACK_TIMEOUT=y
CONFIG_NF_CONNTRACK_TIMESTAMP=y
CONFIG_RMNET_DATA_DEBUG_PKT=y
CONFIG_SECURE_TOUCH=y
CONFIG_TCP_CONG_ADVANCED=y
CONFIG_TCP_CONG_BIC=y
CONFIG_TSPP=y
CONFIG_XFRM_MIGRATE=y
CONFIG_XFRM_SUB_POLICY=y
```

## arch/arm64/configs/variant_lra_us_defconfig
```kconfig
CONFIG_ANDROID_LOGGER=y
CONFIG_BCM43455=y
CONFIG_BCMDHD_FOLLOW_AP_DTIM_PERIOD=y
CONFIG_BCMDHD_HOSTAPD_BGN_MODE=y
CONFIG_CRYPTO=y
CONFIG_INET6_XFRM_MODE_BEET=y
CONFIG_INET6_XFRM_MODE_TRANSPORT=y
CONFIG_INET6_XFRM_MODE_TUNNEL=y
CONFIG_INET6_XFRM_TUNNEL=y
CONFIG_INET_XFRM_MODE_BEET=y
CONFIG_INET_XFRM_MODE_TRANSPORT=y
CONFIG_INET_XFRM_MODE_TUNNEL=y
CONFIG_INET_XFRM_TUNNEL=y
CONFIG_IP_NF_SECURITY=y
CONFIG_LGE_ACG_CARRIER_CODE=y
CONFIG_LGE_NFC_PN547_C2=y
CONFIG_LGE_NFC_SET_IRQ_WAKEUP=y
CONFIG_LGE_NFC=y
CONFIG_LGE_QFPROM_SECHASH="2e1d68a19e9a833d84286fd7aa353d65d793c94ecf5e09623c95be41558f320c"
CONFIG_LOG_CPU_MAX_BUF_SHIFT=15
CONFIG_MACH_LGE=y
CONFIG_MACH_MSM8996_H1_LRA_US=y
CONFIG_MDFPP_CCAUDIT=y
CONFIG_MMC_FFU=n
CONFIG_MMC_SDCARD_NO_CLK_SCALE=y
CONFIG_MSM_BOOT_STATS=y
CONFIG_NET_ACT_GACT=y
CONFIG_NET_ACT_MIRRED=y
CONFIG_NET_ACT_SKBEDIT=y
CONFIG_NET_EMATCH_CMP=y
CONFIG_NET_EMATCH_META=y
CONFIG_NET_EMATCH_NBYTE=y
CONFIG_NET_EMATCH_TEXT=y
CONFIG_NETFILTER_NETLINK_LOG=y
CONFIG_NETFILTER_XT_MATCH_DSCP=y
CONFIG_NETFILTER_XT_MATCH_QUOTA2_LOG=y
CONFIG_NETFILTER_XT_TARGET_LOG=y
CONFIG_NETFILTER_XT_TARGET_NFLOG=y
CONFIG_NETFILTER_XT_TARGET_NOTRACK=y
CONFIG_NETFILTER_XT_TARGET_TEE=y
CONFIG_RMNET_DATA_DEBUG_PKT=y
CONFIG_SECCOMP=y
CONFIG_SECURE_TOUCH=y
CONFIG_TRUSTONIC_TEE=y
CONFIG_XFRM=y
```
